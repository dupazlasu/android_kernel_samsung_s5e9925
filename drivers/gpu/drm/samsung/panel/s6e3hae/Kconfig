## drivers/gpu/drm/samsung/panel/s6e3hae/Kconfig
```kconfig
menuconfig USDM_PANEL_S6E3HAE
	tristate "S6E3HAE DDI Panel Driver"
	depends on USDM_PANEL
	depends on USDM_PANEL_OLED_COMMON
	default n
	help
		This enables S6E3HAE DDI dependent panel drivers of
		common panel driver. say Y, if you have a panel based on
		the S6E3HAE DDI.


########## FOR KUNIT ##########

config S6E3HAE_TEST
	bool "KUnit test for s6e3hae ddi driver"
	depends on SEC_KUNIT
	help
	  TODO: Describe config fully.

config S6E3HAE_COPR_TEST
	bool "KUnit test for s6e3hae ddi copr driver"
	depends on SEC_KUNIT && USDM_PANEL_COPR
	help
	  TODO: Describe config fully.

config S6E3HAE_MDNIE_TEST
	bool "KUnit test for s6e3hae ddi mdnie driver"
	depends on SEC_KUNIT && USDM_MDNIE
	help
	  TODO: Describe config fully.

config S6E3HAE_MAFPC_TEST
	bool "KUnit test for s6e3hae ddi mafpc driver"
	depends on SEC_KUNIT && USDM_PANEL_MAFPC
	help
	  TODO: Describe config fully.

config S6E3HAE_FAC_TEST
	bool "KUnit test for s6e3hae ddi factory mode driver"
	depends on SEC_KUNIT
	help
	  TODO: Describe config fully.

config S6E3HAE_AOD_TEST
	bool "KUnit test for s6e3hae ddi aod driver"
	depends on SEC_KUNIT && USDM_PANEL_LPM
	help
	  TODO: Describe config fully.



########## FOR KUNIT ##########
```
